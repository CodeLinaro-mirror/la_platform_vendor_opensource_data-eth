## drivers/emac_ctrl_fe/Kconfig
```kconfig
# SPDX-License-Identifier: GPL-2.0-only

config EMAC_CTRL_FE
	tristate "EMAC Control Front End"
	depends on ARCH_QCOM
	help
		Emac Control Front end driver.
		This provides an interface for the thin driver
		to interact with the dma_be driver present at the
		qnx side to enable DMA Virtualization.

		Say Y here to compile support for Emac Front End Driver driver
		into the kernel or say M to compile as a module.
```

## drivers/emac_shim/Kconfig
```kconfig
# SPDX-License-Identifier: GPL-2.0-only

config EMAC_SHIM
	tristate "Emac Thin Driver"
	depends on ARCH_QCOM
	help
		Emac THin Driver for DMA Virtualization.
		This provides a eth interface to virtually access
		DMA Channels from Host EMAC to transfer data.

		Say Y here to compile support for EMAC thin driver
		into the kernel or say M to compile as a module.

config DATAETH
	tristate "Data-eth component"
	help
		Data-eth component to enable any module whose config is not present.

		Say Y here to compile support for Data-eth component
		into the kernel or say M to compile as a module.
config EMAC_SHIM_GY
	tristate "Data-eth component"
	help
		Data-eth component to enable any module whose config is not present.

		Say Y here to compile support for Data-eth component
		into the kernel or say M to compile as a module.
```
